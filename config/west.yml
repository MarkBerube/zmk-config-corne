## config/west.yml
```yaml
manifest:
  remotes:
    - name: zmkfirmware
      url-base: https://github.com/zmkfirmware
    # Additional modules containing boards/shields/custom code can be listed here as well
    # See https://docs.zephyrproject.org/3.2.0/develop/west/manifest.html#projects
  projects:
    - name: zmk
      remote: zmkfirmware
      revision: 4de313367288aad5aeaa1243890e40dc813f7008
      import: app/west.yml
    - name: corne-display-art
      url: https://github.com/MarkBerube/corne-wireless-view-zmk-config
      revision: 4ba56971fe296dce2f69e93333346b549db6afaa
  self:
    path: config
```
